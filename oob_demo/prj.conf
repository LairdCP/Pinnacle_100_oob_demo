## CMakeLists.txt
```
cmake_minimum_required(VERSION 3.13.1)

# Re-direct the directory where the 'boards' directory is found from
# $ZEPHYR_BASE to this directory.
set(BOARD_ROOT ${CMAKE_CURRENT_LIST_DIR}/../)

find_package(Zephyr REQUIRED HINTS $ENV{ZEPHYR_BASE})
project(oob_demo)

target_sources(app PRIVATE
    ${CMAKE_SOURCE_DIR}/src/main.c
    ${CMAKE_SOURCE_DIR}/src/lte.c
    ${CMAKE_SOURCE_DIR}/src/nv.c
    ${CMAKE_SOURCE_DIR}/src/single_peripheral.c
    ${CMAKE_SOURCE_DIR}/src/jsmn_share.c
)

include_directories(${CMAKE_SOURCE_DIR}/include)
include_directories(${CMAKE_SOURCE_DIR}/framework_config)
include_directories(${CMAKE_SOURCE_DIR}/../../modules/jsmn)

if(CONFIG_LWM2M)
include_directories(${CMAKE_SOURCE_DIR}/lwm2m/include)
target_sources(app PRIVATE
    ${CMAKE_SOURCE_DIR}/lwm2m/source/lcz_lwm2m_client.c
    ${CMAKE_SOURCE_DIR}/lwm2m/source/ble_lwm2m_service.c
)
endif()

if(CONFIG_BLUEGRASS)
include_directories(${CMAKE_SOURCE_DIR}/bluegrass/include)
FILE(GLOB bluegrass_sources ${CMAKE_SOURCE_DIR}/bluegrass/source/*.c)
target_sources(app PRIVATE
    ${bluegrass_sources}
    ${CMAKE_SOURCE_DIR}/src/aws.c
    ${CMAKE_SOURCE_DIR}/src/ble_aws_service.c
)
if(CONFIG_SHELL AND CONFIG_APP_AWS_CUSTOMIZATION)
target_sources(app PRIVATE
    ${CMAKE_SOURCE_DIR}/src/aws_config.c
)
endif()
endif()

if(CONFIG_BL654_SENSOR)
include_directories(${CMAKE_SOURCE_DIR}/bl654_sensor/include)
target_sources(app PRIVATE ${CMAKE_SOURCE_DIR}/bl654_sensor/source/ble_sensor_service.c)
target_sources(app PRIVATE ${CMAKE_SOURCE_DIR}/bl654_sensor/source/bl654_sensor.c)
endif()

if (CONFIG_COAP_FOTA)
include_directories(${CMAKE_SOURCE_DIR}/coap/include)
target_sources(app PRIVATE
    ${CMAKE_SOURCE_DIR}/coap/source/coap_fota_json_parser.c
    ${CMAKE_SOURCE_DIR}/coap/source/coap_fota.c
    ${CMAKE_SOURCE_DIR}/coap/source/coap_fota_shadow.c
    ${CMAKE_SOURCE_DIR}/coap/source/coap_fota_task.c
)
endif() # CONFIG_COAP_FOTA
```

## Kconfig
```
# Copyright (c) 2020 Laird Connectivity
# SPDX-License-Identifier: Apache-2.0

menuconfig USER_APPLICATION
     bool "Config User Application"
	 default y

if USER_APPLICATION

config LAIRD_CONNECTIVITY_DEBUG
    bool
    default n

config SENSOR_MAX_AD_SIZE
    int "The maximum size for ads sent to sensor task"
    default 67
    help
        67 - BT510 coded PHY advertisement
        31 - BT510 1M PHY advertisement and scan response

menuconfig BL654_SENSOR
    bool "BL654 sensor support"
    default y

if BL654_SENSOR

config BL654_SENSOR_SEND_TO_AWS_RATE_SECONDS
    int "The period at which to send BL654 Sensor data to AWS"
    default 60
    range 30 3600

config BL654_SENSOR_NAME
    string "The advertised name of the BL654 sensor (that is scanned for)"
    default "BL654 BME280 Sensor"
    help
        Any sensor with the ESS service should work
        (temperature, humidity, and pressure).

endif # BL654_SENSOR

config SCAN_FOR_BT510
    bool "Parse Bluetooth advertisements for BT510 Sensor"
    default y

config SCAN_FOR_BT510_CODED
    bool "Scan for coded PHY and 1M advertisements from BT510"
    default y
    depends on SCAN_FOR_BT510
    depends on BT_EXT_ADV
    depends on BT_LL_NRFXLIB_VS_INCLUDE
    depends on BT_LL_NRFXLIB_DEFAULT
    help
        Coded PHY (extended advertisements) requires Nordic binary

config CLOUD_QUEUE_SIZE
    int "The size of queue for sending messages to AWS or LWM2M client"
    default 32

config CLOUD_PURGE_THRESHOLD
    int "The threshold at which the cloud queue is purged."
    default 24

config CLOUD_FIFO_CHECK_RATE_SECONDS
    int "The rate at which the cloud fifo is checked"
    default 1

config AWS_TOPIC_MAX_SIZE
    int "Maximum size for AWS topic strings"
    default 64

menuconfig BLUEGRASS
    bool "Laird Connectivity Bluegrass cloud"
    help
        Send sensor data to Bluegrass cloud platform

if BLUEGRASS

config AWS_DATA_SEND_LED_OFF_DURATION_MILLISECONDS
    int "The amount of time to turn off the green LED when data is sent"
    default 30
    range 1 1000
    help
        Green LED is turned on when connected to AWS.
        Green LED is flashed off when data is sent.
        Implemented using sleep.
        Subscription processing doesn't blink green LED.

config AWS_KEEP_ALIVE_SECONDS
    int "The modem's RSSI is sent at this rate to keep AWS connection alive"
    default 30
    range 1 80
    help
        This can't be more than the AWS connection timeout.

config USE_SINGLE_AWS_TOPIC
    bool "Send all sensor data to gateway topic"
    help
        PSM mode doesn't easily support receiving information from the
        Laird Connectivity Cloud demo.
        When using a single topic [BT510] temperature data is sent to the
        gateway's topic vs. the individual sensor topic.
        BL654 sensor data is always sent to the gateway topic.

config APP_CA_CERT_TAG
    int "mbedTLS tag for CA"
    default 1

config APP_DEVICE_CERT_TAG
    int "mbedTLS tag for device cert and private key"
    default 2

config JSON_BRACKET_BUFFER_SIZE
    int "The maximum size JSON message that can be processed"
    default 1536
    help
        This applies to sensor messages received over Bluetooth.

config SENSOR_TOPIC_FMT_STR_PREFIX
	string "Default location for sensor data"
	default "$aws/things/%s/shadow"
    help
        "%s will be replaced by the sensor BT address"

config SHADOW_IN_MAX_SIZE
    int "Maximum size of subscription/shadow that can be processed"
    default 8192
    help
        The timestamps can make the shadow larger than 7K bytes.

config SENSOR_TABLE_SIZE
    int "Number of sensors that can be monitored"
    default 15
    range 0 15

config SENSOR_LOG_MAX_SIZE
    int "The maximum number of stored sensor events"
    default 30
    range 1 30
    help
        Limited by the memory pool
        Limited by MQTT or modem.

config SENSOR_SUBSCRIPTION_DELAY_SECONDS
    int "The number of seconds to wait after a sensor is whitelisted before subscribing to the delta and get topics."
    default 10
    range 6 60
    help
        The server needs time to generate the sensor object.
        When the permissions are changed on AWS a disconnect may occur.

config VSP_TX_ECHO
    bool "Print Virtual Serial Port data transmitted to sensors"
    help
        This occurs in task context because strings can be long

config VSP_RX_ECHO
    bool "Print Virtual Serial Port data received from sensors"
    help
        This occurs in task context because strings can be long

config APP_AWS_MAX_CREDENTIAL_SIZE
    int "AWS max credential size"
    default 2560
    help
        Maximum size of a credential. Used to allocate a buffer for
        storing credentials.

config APP_AWS_CLIENT_ID_MAX_LENGTH
    int "AWS clint ID max length"
    default 32
    help
        Max length AWS client ID. This is used for the MQTT connection ID.

config APP_AWS_ENDPOINT_MAX_LENGTH
    int "AWS endpoint max length"
    default 256
    help
        Max length of AWS endpoint hostname.

endif # BLUEGRASS

config JSON_LOG_PUBLISH
    bool "Print data published to AWS"

config JSON_LOG_TOPIC
    bool "Print the topic that documents are published to or received from"

config JSON_LOG_MQTT_RX_DATA
    bool "Enable/Disable printing of received MQTT data."

menuconfig LC_LWM2M
    bool "Laird Connectivity LWM2M Demo Options"
    depends on LWM2M

if LC_LWM2M

config LWM2M_ENABLE_PSK_GENERATION
    bool "Allow new PSK to be generated over Bluetooth"
    default y

config LWM2M_PSK_SIZE
    int
    default 16

config LWM2M_CLIENT_ID_MAX_SIZE
    int "Maximum size of the client id string"
    default 32
    range 1 64

config LWM2M_PEER_URL_MAX_SIZE
    int "Maximum size of the peer URL string"
    default 128
    range 1 512

config LWM2M_CLIENT_ENDPOINT_MAX_SIZE
    int "Maximum size of the client endpoint name"
    default 64

config LWM2M_PSK_TAG
    int "Tag used by TLS for referencing PSK"
    depends on LWM2M_DTLS_SUPPORT
    default 3
    help
        Must be unique in the system.

endif # LC_LWM2M

config JSMN_NUMBER_OF_TOKENS
    int "The number of tokens for jsmn"
    default 512
    help
        JSMN is used to process shadow and CoAP messages.
        The maximum size of the shadow (and tokens required) is affected by
        the number of sensors and the sensor log size.  The timestamps that are
        generated by AWS make the shadow large.

config APP_AWS_CUSTOMIZATION
    bool "Customize AWS connection"
    help
        Enabling this gives the user the ability to adjust all the pertinent AWS
        connection options via UART commands. This gives the user the ability
        to change what AWS server their device connects to.

if APP_AWS_CUSTOMIZATION

config APP_AWS_ROOT_CA_FILE_NAME
    string "Root CA file name"
    default "root_ca.pem"
    help
        Name of the file that the will be read from the filesystem

config APP_AWS_CLIENT_CERT_FILE_NAME
    string "Client cert file name"
    default "client_cert.pem"
    help
        Name of the file that the will be read from the filesystem

config APP_AWS_CLIENT_KEY_FILE_NAME
    string "Client key file name"
    default "client_key.pem"
    help
        Name of the file that the will be read from the filesystem

endif # APP_AWS_CUSTOMIZATION

source "../oob_demo/oob_demo/coap/Kconfig"

endif # USER_APPLICATION

source "../modules/framework/Kconfig"

source "Kconfig.zephyr"
```

## prj.conf
```kconfig
# General
CONFIG_MAIN_STACK_SIZE=8192
CONFIG_HEAP_MEM_POOL_SIZE=10240
CONFIG_NEWLIB_LIBC=y
CONFIG_NEWLIB_LIBC_FLOAT_PRINTF=y

# Debugging
# Use one of the following two options if debugging with breakpoints
# CONFIG_NO_OPTIMIZATIONS=y
# CONFIG_DEBUG_OPTIMIZATIONS=y

# App
CONFIG_BLUEGRASS=y
CONFIG_APP_AWS_CUSTOMIZATION=y
CONFIG_COAP_FOTA_BASE64=y
CONFIG_COAP_FOTA_PRODUCT="pinnacle-100-dvk"
CONFIG_SENSOR_TABLE_SIZE=5

# App debug
# CONFIG_VSP_TX_ECHO=y
# CONFIG_VSP_RX_ECHO=y
# CONFIG_JSON_LOG_ENABLED=y
# CONFIG_JSON_LOG_PUBLISH=y
# CONFIG_JSON_LOG_TOPIC=y
# CONFIG_JSON_LOG_MQTT_RX_DATA=y

# Bluetooth
CONFIG_BT=y
CONFIG_BT_GATT_DYNAMIC_DB=y
CONFIG_BT_CTLR_TX_PWR_PLUS_8=y
CONFIG_BT_CTLR_COMPANY_ID=0x0077
CONFIG_BT_MAX_CONN=3
CONFIG_BT_CTLR_DATA_LENGTH_MAX=251
CONFIG_BT_CTLR_TX_BUFFER_SIZE=251
CONFIG_BT_L2CAP_TX_MTU=260
CONFIG_BT_RX_BUF_LEN=260
CONFIG_BT_RX_STACK_SIZE=2048
# Allow Coded PHY (requires Nordic Bluetooth host)
CONFIG_BT_EXT_ADV=y
CONFIG_BT_LL_NRFXLIB_VS_INCLUDE=y
CONFIG_BT_LL_NRFXLIB_DEFAULT=y
# BLE Central settings
CONFIG_BT_CENTRAL=y
CONFIG_BT_GATT_CLIENT=y
# Enable simultaneous advertising and scanning
# (zephyr doesn't allow multiple random addresses)
CONFIG_BT_PRIVACY=n
CONFIG_BT_SCAN_WITH_IDENTITY=y
# The BT510 advertises at a 1-second rate (default of 3 seconds is too short)
CONFIG_BT_CREATE_CONN_TIMEOUT=6
# BLE Peripheral settings
CONFIG_BT_PERIPHERAL=y
CONFIG_BT_DEVICE_NAME="Pinnacle 100 OOB"
CONFIG_BT_DEVICE_NAME_DYNAMIC=y
# BLE security
CONFIG_BT_SMP=y
CONFIG_BT_BONDABLE=n
CONFIG_BT_MAX_PAIRED=3
# BLE debug
# CONFIG_BT_DEBUG_LOG=y
# CONFIG_BT_DEBUG_CONN=y
# CONFIG_BT_DEBUG_SMP=y

# modem settings
CONFIG_MODEM=y
CONFIG_MODEM_HL7800=y
CONFIG_MODEM_HL7800_RAT_M1=y
# CONFIG_MODEM_LOG_LEVEL_DBG=y
CONFIG_MODEM_HL7800_FW_UPDATE=y
CONFIG_MODEM_HL7800_RECV_BUF_CNT=64
CONFIG_NET_BUF_RX_COUNT=64

# NETWORKING
CONFIG_NETWORKING=y
CONFIG_NET_IPV4=y
CONFIG_NET_IPV6=n
CONFIG_NET_MGMT=y
CONFIG_NET_MGMT_EVENT=y
CONFIG_NET_SOCKETS=y
CONFIG_NET_SOCKETS_POSIX_NAMES=y
CONFIG_NET_SOCKETS_NET_MGMT=y
CONFIG_NET_SOCKETS_NET_MGMT_MAX_LISTENERS=3
CONFIG_NET_TCP=y
CONFIG_NET_CONFIG_INIT_TIMEOUT=2
CONFIG_NET_SHELL=y
CONFIG_NET_BUF_POOL_USAGE=y
CONFIG_COAP=y
CONFIG_NET_UDP=y

# Enable the DNS resolver
CONFIG_DNS_RESOLVER=y
CONFIG_NET_SOCKETS_DNS_TIMEOUT=10000

# MQTT
CONFIG_MQTT_LIB=y
# Security
CONFIG_MQTT_LIB_TLS=y
CONFIG_NET_SOCKETS_SOCKOPT_TLS=y
CONFIG_NET_SOCKETS_ENABLE_DTLS=y
CONFIG_NET_SOCKETS_TLS_MAX_CONTEXTS=2
CONFIG_TLS_MAX_CREDENTIALS_NUMBER=3
# TLS configuration
CONFIG_MBEDTLS=y
CONFIG_MBEDTLS_DTLS=y
CONFIG_MBEDTLS_BUILTIN=y
CONFIG_MBEDTLS_ENABLE_HEAP=y
CONFIG_MBEDTLS_HEAP_SIZE=55000
CONFIG_MBEDTLS_SSL_MAX_CONTENT_LEN=8192
CONFIG_MBEDTLS_PEM_CERTIFICATE_FORMAT=y
CONFIG_MBEDTLS_KEY_EXCHANGE_PSK_ENABLED=y
# Use format supported by Californium (CoAP bridge) and AWS.
CONFIG_MBEDTLS_KEY_EXCHANGE_ECDHE_ECDSA_ENABLED=y
CONFIG_MBEDTLS_ECP_ALL_ENABLED=y
CONFIG_MBEDTLS_CIPHER_GCM_ENABLED=y

# JSON used by AWS task
CONFIG_JSON_LIBRARY=y

# Storage
CONFIG_NVS=y
CONFIG_MPU_ALLOW_FLASH_WRITE=y
CONFIG_FLASH=y
CONFIG_FCB=y
CONFIG_FLASH_MAP=y
CONFIG_FLASH_PAGE_LAYOUT=y

# Enable mcumgr to support FOTA
CONFIG_MCUMGR=y
CONFIG_MCUMGR_SMP_SHELL=y
CONFIG_MCUMGR_SMP_SHELL_MTU=2048
CONFIG_MCUMGR_BUF_SIZE=2050
CONFIG_MGMT_CBORATTR_MAX_SIZE=2048
CONFIG_FS_MGMT_UL_CHUNK_SIZE=2048
# Enable the Bluetooth (unauthenticated) mcumgr transport.
CONFIG_MCUMGR_SMP_BT=y
CONFIG_MCUMGR_SMP_BT_AUTHEN=n

CONFIG_MCUMGR_CMD_IMG_MGMT=y
CONFIG_MCUMGR_CMD_OS_MGMT=y
CONFIG_MCUMGR_CMD_FS_MGMT=y
# Enable large files at the expense of larger CBOR encoding.
CONFIG_FS_MGMT_MAX_FILE_SIZE_4GB=y
# Some command handlers require a large stack.
CONFIG_SYSTEM_WORKQUEUE_STACK_SIZE=4096

# Enable the LittleFS file system.
CONFIG_FILE_SYSTEM=y
CONFIG_FILE_SYSTEM_LITTLEFS=y

# Enable QSPI (MX25R64)
CONFIG_NORDIC_QSPI_NOR=y
CONFIG_NORDIC_QSPI_NOR_FLASH_LAYOUT_PAGE_SIZE=4096
CONFIG_NORDIC_QSPI_NOR_FLASH_ALLOW_STACK_USAGE_FOR_DATA_IN_FLASH=y
CONFIG_PM_EXTERNAL_FLASH=y
CONFIG_PM_EXTERNAL_FLASH_DEV_NAME="MX25R64"
CONFIG_PM_EXTERNAL_FLASH_SIZE=0x800000
CONFIG_PM_EXTERNAL_FLASH_BASE=0x0

# command line shell
CONFIG_SHELL=y
CONFIG_SHELL_HISTORY=n
CONFIG_KERNEL_SHELL=y
CONFIG_FILE_SYSTEM_SHELL=y

# Log messages
CONFIG_LOG=y
CONFIG_LOG_BUFFER_SIZE=2048
# for logging more dynamic strings
CONFIG_LOG_STRDUP_BUF_COUNT=16
CONFIG_LOG_STRDUP_MAX_STRING=64

# Networking debug
CONFIG_NET_LOG=y
# CONFIG_NET_SOCKETS_LOG_LEVEL_DBG=y
CONFIG_NET_SOCKETS_LOG_LEVEL_ERR=y
CONFIG_MBEDTLS_DEBUG=y
CONFIG_MBEDTLS_DEBUG_LEVEL=1
# CONFIG_NET_MGMT_EVENT_LOG_LEVEL_DBG=y

# Segger debugging tools
# CONFIG_SEGGER_SYSTEMVIEW=y
# CONFIG_USE_SEGGER_RTT=y

# Thread Debug
CONFIG_INIT_STACKS=y
CONFIG_THREAD_ANALYZER=y
CONFIG_THREAD_NAME=y
CONFIG_THREAD_MAX_NAME_LEN=12
#CONFIG_HW_STACK_PROTECTION=y
#CONFIG_STACK_SENTINEL=y
#CONFIG_STACK_CANARIES=y

# ADC for power measurement
CONFIG_ADC=y
CONFIG_ADC_NRFX_SAADC=y

# Allows rebooting in zephyr
CONFIG_REBOOT=y

# Message Framework
CONFIG_FWK_ASSERT_ENABLED=y
CONFIG_BUFFER_POOL_SIZE=16384

# Laird Connectivity Zephyr
CONFIG_LCZ_AD_FIND=y
CONFIG_LCZ_BT_SCAN=y

CONFIG_BLE_CELLULAR_SERVICE=y
CONFIG_BLE_POWER_SERVICE=y
CONFIG_LCZ_BLE_DIS=y

CONFIG_FILE_SYSTEM_UTILITIES=y
CONFIG_FOTA_SERVICE=y

CONFIG_LCZ_QRTC=y
CONFIG_LCZ_LED=y
CONFIG_LCZ_DNS=y
CONFIG_LCZ_POWER=y
CONFIG_LCZ_SOCK=y

# Use the Laird Connectivity Zephyr Library
CONFIG_COMPONENT_LIB=y

#NFC Support
CONFIG_LCZ_NFC=y
```

## overlay_lwm2m_dtls.conf
```kconfig
# turn off unused features
CONFIG_BT_SMP=n
CONFIG_NET_TCP=n
CONFIG_MQTT_LIB=n
CONFIG_MQTT_LIB_TLS=n
CONFIG_BLUEGRASS=n
CONFIG_SCAN_FOR_BT510=n

CONFIG_HEAP_MEM_POOL_SIZE=8192

CONFIG_LWM2M_LOG_LEVEL_DBG=y
CONFIG_NET_PKT_RX_COUNT=10
CONFIG_NET_PKT_TX_COUNT=10
CONFIG_NET_BUF_RX_COUNT=10
CONFIG_NET_BUF_TX_COUNT=10
CONFIG_NET_MAX_CONTEXTS=5
CONFIG_NET_CONFIG_SETTINGS=y

CONFIG_LWM2M=y
CONFIG_LC_LWM2M=y
CONFIG_LWM2M_IPSO_SUPPORT=y
CONFIG_LWM2M_IPSO_LIGHT_CONTROL=y
CONFIG_LWM2M_IPSO_TEMP_SENSOR=y
# TODO: need to add support for these
# CONFIG_LWM2M_IPSO_HUMIDITY_SENSOR=y
# CONFIG_LWM2M_IPSO_PRESSURE_SENSOR=y

CONFIG_LWM2M_DTLS_SUPPORT=y
CONFIG_LWM2M_PEER_PORT=5684

# Special MbedTLS changes
CONFIG_MBEDTLS_CIPHER_CCM_ENABLED=y

# Disable RSA, we don't parse certs: saves flash/memory
CONFIG_MBEDTLS_KEY_EXCHANGE_RSA_ENABLED=n
# Enable PSK instead
CONFIG_MBEDTLS_KEY_EXCHANGE_PSK_ENABLED=y

CONFIG_NET_SOCKETS_TLS_MAX_CONTEXTS=4
CONFIG_NET_SOCKETS_ENABLE_DTLS=y

# NB-IoT
CONFIG_MODEM_HL7800_DEFAULT_RAT=1
# The latency in NB-IoT can be 10 seconds.
# these values need to be greater than 10 seconds to account for the
# the latency of the connection after the cell tower.
CONFIG_NET_SOCKETS_CONNECT_TIMEOUT=13000
CONFIG_NET_SOCKETS_DTLS_TIMEOUT=15000
CONFIG_COAP_INIT_ACK_TIMEOUT_MS=15000
```

## include/ad_find.h
```c
/**
 * @file ad_find.h
 * @brief Find TLV (type, length, value) structures in advertisements.
 *
 * Copyright (c) 2020 Laird Connectivity
 *
 * SPDX-License-Identifier: Apache-2.0
 */
#ifndef __AD_FIND_H__
#define __AD_FIND_H__

/******************************************************************************/
/* Includes                                                                   */
/******************************************************************************/
#include <zephyr/types.h>

#ifdef __cplusplus
extern "C" {
#endif

/******************************************************************************/
/* Global Constants, Macros and Type Definitions                              */
/******************************************************************************/
#define BT_DATA_INVALID 0x00

typedef struct AdHandle {
	u8_t *pPayload;
	size_t size;
} AdHandle_t;

/******************************************************************************/
/* Global Function Prototypes                                                 */
/******************************************************************************/
/**
 * @brief Finds a TLV in advertisement
 *
 * @param pAdv pointer to advertisement data
 * @param Length length of the data
 * @param Type1 type of TLV to find
 * @param Type2 second type of tlv to find, set to BT_DATA_INVALID when not used.
 * Parsing will stop on first type found.
 *
 * @retval AdHandle_t - pointer to payload if found otherwise NULL
 */
AdHandle_t AdFind_Type(u8_t *pAdv, size_t Length, u8_t Type1, u8_t Type2);

/**
 * @brief Finds a short or complete name in advertisement.
 *
 * @retval AdHandle_t pointer to payload if found otherwise NULL
 */
AdHandle_t AdFind_Name(u8_t *pAdv, size_t Length);

/**
 * @brief Compares name string with name field in advertisement.
 *
 * @retval true if name field is in advertisement and NameLength bytes match,
 * otherwise false
 */
bool AdFind_MatchName(u8_t *pAdv, size_t Length, char *Name, size_t NameLength);

#ifdef __cplusplus
}
#endif

#endif /* __AD_FIND_H__ */
```

## include/app_version.h
```c
/**
 * @file app_version.h
 * @brief
 *
 * Copyright (c) 2020 Laird Connectivity
 *
 * SPDX-License-Identifier: Apache-2.0
 */
#ifndef __APP_VERSION_H__
#define __APP_VERSION_H__

#ifdef __cplusplus
extern "C" {
#endif

/******************************************************************************/
/* Application Firmware Version                                               */
/******************************************************************************/
#define APP_VERSION_MAJOR 2
#define APP_VERSION_MINOR 1
#define APP_VERSION_PATCH 0
#define APP_VERSION_STRING                                                     \
	STRINGIFY(APP_VERSION_MAJOR)                                           \
	"." STRINGIFY(APP_VERSION_MINOR) "." STRINGIFY(APP_VERSION_PATCH)

#ifdef __cplusplus
}
#endif

#endif /* __APP_VERSION_H__ */
```

## include/aws.h
```c
/**
 * @file aws.h
 * @brief Amazon Web Services API
 *
 * Copyright (c) 2020 Laird Connectivity
 *
 * SPDX-License-Identifier: Apache-2.0
 */
#ifndef __AWS_H__
#define __AWS_H__

/******************************************************************************/
/* Includes                                                                   */
/******************************************************************************/
#include <data/json.h>

#ifdef __cplusplus
extern "C" {
#endif

/******************************************************************************/
/* Global Constants, Macros and Type Definitions                              */
/******************************************************************************/
/* AWS Root CA obtained from
*  https://docs.aws.amazon.com/iot/latest/developerguide/managing-device-certs.html
*/
static const unsigned char aws_root_ca[] =
	"-----BEGIN CERTIFICATE-----\n"
	"MIIDQTCCAimgAwIBAgITBmyfz5m/jAo54vB4ikPmljZbyjANBgkqhkiG9w0BAQsF\n"
	"ADA5MQswCQYDVQQGEwJVUzEPMA0GA1UEChMGQW1hem9uMRkwFwYDVQQDExBBbWF6\n"
	"b24gUm9vdCBDQSAxMB4XDTE1MDUyNjAwMDAwMFoXDTM4MDExNzAwMDAwMFowOTEL\n"
	"MAkGA1UEBhMCVVMxDzANBgNVBAoTBkFtYXpvbjEZMBcGA1UEAxMQQW1hem9uIFJv\n"
	"b3QgQ0EgMTCCASIwDQYJKoZIhvcNAQEBBQADggEPADCCAQoCggEBALJ4gHHKeNXj\n"
	"ca9HgFB0fW7Y14h29Jlo91ghYPl0hAEvrAIthtOgQ3pOsqTQNroBvo3bSMgHFzZM\n"
	"9O6II8c+6zf1tRn4SWiw3te5djgdYZ6k/oI2peVKVuRF4fn9tBb6dNqcmzU5L/qw\n"
	"IFAGbHrQgLKm+a/sRxmPUDgH3KKHOVj4utWp+UhnMJbulHheb4mjUcAwhmahRWa6\n"
	"VOujw5H5SNz/0egwLX0tdHA114gk957EWW67c4cX8jJGKLhD+rcdqsq08p8kDi1L\n"
	"93FcXmn/6pUCyziKrlA4b9v7LWIbxcceVOF34GfID5yHI9Y/QCB/IIDEgEw+OyQm\n"
	"jgSubJrIqg0CAwEAAaNCMEAwDwYDVR0TAQH/BAUwAwEB/zAOBgNVHQ8BAf8EBAMC\n"
	"AYYwHQYDVR0OBBYEFIQYzIU07LwMlJQuCFmcx7IQTgoIMA0GCSqGSIb3DQEBCwUA\n"
	"A4IBAQCY8jdaQZChGsV2USggNiMOruYou6r4lK5IpDB/G/wkjUu0yKGX9rbxenDI\n"
	"U5PMCCjjmCXPI6T53iHTfIUJrU6adTrCC2qJeHZERxhlbI1Bjjt/msv0tadQ1wUs\n"
	"N+gDS63pYaACbvXy8MWy7Vu33PqUXHeeE6V/Uq2V8viTO96LXFvKWlJbYK8U90vv\n"
	"o/ufQJVtMVT8QtPHRh8jrdkPSHCa2XV4cdFyQzR1bldZwgJcJmApzyMZFo6IQ6XU\n"
	"5MsI+yMRQ+hDKXJioaldXgjUkK642M4UwtBV8ob2xJNDd2ZhwLnoQdeXeGADbkpy\n"
	"rqXRfboQnoZsG4q5WTP468SQvvG5\n"
	"-----END CERTIFICATE-----\n";

#define AWS_DEFAULT_ENDPOINT "a3273rvo818l4w-ats.iot.us-east-1.amazonaws.com"

#define SERVER_PORT_STR "8883"

#define APP_SLEEP_MSECS 500

#define PUBLISH_TIMEOUT_TICKS K_SECONDS(5)

#define APP_CONNECT_TRIES 1

#define APP_MQTT_BUFFER_SIZE 1024

#define DEFAULT_MQTT_CLIENTID "pinnacle100_oob"
#define AWS_MQTT_ID_MAX_SIZE 128

#define SHADOW_STATE_NULL "{\"state\":null}"

#define SHADOW_REPORTED_START "{\"state\":{\"reported\":{"
#define SHADOW_REPORTED_END "}}}"

#define SHADOW_TEMPERATURE "\"temperature\":"
#define SHADOW_HUMIDITY "\"humidity\":"
#define SHADOW_PRESSURE "\"pressure\":"
#define SHADOW_RADIO_RSSI "\"radio_rssi\":"
#define SHADOW_RADIO_SINR "\"radio_sinr\":"

#define AWS_RX_THREAD_STACK_SIZE 4096
#define AWS_RX_THREAD_PRIORITY K_PRIO_COOP(15)

#define GATEWAY_TOPIC NULL

#define CLEAR_SHADOW_ON_STARTUP 0

struct shadow_persistent_values {
	const char *firmware_version;
	const char *os_version;
	const char *radio_version;
	const char *IMEI;
	const char *ICCID;
	const char *radio_sn;
	bool codedPhySupported;
};

struct shadow_state_reported {
	struct shadow_persistent_values reported;
};

struct shadow_reported_struct {
	struct shadow_state_reported state;
};

static const struct json_obj_descr shadow_persistent_values_descr[] = {
	JSON_OBJ_DESCR_PRIM(struct shadow_persistent_values, firmware_version,
			    JSON_TOK_STRING),
	JSON_OBJ_DESCR_PRIM(struct shadow_persistent_values, os_version,
			    JSON_TOK_STRING),
	JSON_OBJ_DESCR_PRIM(struct shadow_persistent_values, radio_version,
			    JSON_TOK_STRING),
	JSON_OBJ_DESCR_PRIM(struct shadow_persistent_values, IMEI,
			    JSON_TOK_STRING),
	JSON_OBJ_DESCR_PRIM(struct shadow_persistent_values, ICCID,
			    JSON_TOK_STRING),
	JSON_OBJ_DESCR_PRIM(struct shadow_persistent_values, radio_sn,
			    JSON_TOK_STRING),
	JSON_OBJ_DESCR_PRIM(struct shadow_persistent_values, codedPhySupported,
			    JSON_TOK_TRUE),
};

static const struct json_obj_descr shadow_state_reported_descr[] = {
	JSON_OBJ_DESCR_OBJECT(struct shadow_state_reported, reported,
			      shadow_persistent_values_descr),
};

static const struct json_obj_descr shadow_descr[] = {
	JSON_OBJ_DESCR_OBJECT(struct shadow_reported_struct, state,
			      shadow_state_reported_descr),
};

/******************************************************************************/
/* Global Function Prototypes                                                 */
/******************************************************************************/
int awsInit(void);
int awsSetCredentials(const uint8_t *cert, const uint8_t *key);
void awsSetRootCa(const char *cred);
void awsSetEndpoint(const char *ep);
void awsSetClientId(const char *id);
int awsGetServerAddr(void);
int awsConnect(void);
bool awsConnected(void);
void awsDisconnect(void);
int awsKeepAlive(void);
int awsSendData(char *data, uint8_t *topic);
int awsPublishShadowPersistentData(void);
int awsSetShadowKernelVersion(const char *version);
int awsSetShadowIMEI(const char *imei);
int awsSetShadowICCID(const char *iccid);
int awsSetShadowRadioSerialNumber(const char *sn);
int awsSetShadowRadioFirmwareVersion(const char *version);
int awsSetShadowAppFirmwareVersion(const char *version);
int awsPublishBl654SensorData(float temperature, float humidity,
			      float pressure);
int awsPublishPinnacleData(int radioRssi, int radioSinr);
int awsSubscribe(uint8_t *topic, uint8_t subscribe);
int awsGetShadow(void);
int awsGetAcceptedSubscribe(void);
int awsGetAcceptedUnsub(void);
void awsGenerateGatewayTopics(const char *imei);
void awsDisconnectCallback(void);

#ifdef __cplusplus
}
#endif

#endif /* __AWS_H__ */
```

## include/ble_aws_service.h
```c
/*
 * Copyright (c) 2019 Laird Connectivity
 *
 * SPDX-License-Identifier: Apache-2.0
 */

#ifndef __BLE_AWS_SERVICE_H__
#define __BLE_AWS_SERVICE_H__

#define AWS_CLIENT_ID_MAX_LENGTH 32
#define AWS_ENDPOINT_MAX_LENGTH 256
#define AWS_ROOT_CA_MAX_LENGTH 2048
#define AWS_CLIENT_CERT_MAX_LENGTH 2048
#define AWS_CLIENT_KEY_MAX_LENGTH 2048

enum aws_status {
	AWS_STATUS_NOT_PROVISIONED,
	AWS_STATUS_DISCONNECTED,
	AWS_STATUS_CONNECTED,
	AWS_STATUS_CONNECTION_ERR
};

enum aws_svc_err {
	AWS_SVC_ERR_NONE = 0,
	AWS_SVC_ERR_INIT_ENDPOINT = -1,
	AWS_SVC_ERR_INIT_CLIENT_ID = -2,
	AWS_SVC_ERR_INIT_ROOT_CA = -3,
};

enum aws_svc_event {
    AWS_SVC_EVENT_SETTINGS_SAVED,
    AWS_SVC_EVENT_SETTINGS_CLEARED,
};

/**
 * @brief Callback function prototype for AWS service events
 * 
 */
typedef void (*aws_svc_event_function_t)(enum aws_svc_event event);

int aws_svc_init(const char *clientId);
void aws_svc_set_client_id(const char *id);
void aws_svc_set_endpoint(const char *ep);
void aws_svc_set_status(struct bt_conn *conn, enum aws_status status);
void aws_svc_set_root_ca(const char *cred);
void aws_svc_set_client_cert(const char *cred);
void aws_svc_set_client_key(const char *cred);
bool aws_svc_client_cert_is_stored(void);
bool aws_svc_client_key_is_stored(void);
const char *aws_svc_get_client_cert(void);
const char *aws_svc_get_client_key(void);
int aws_svc_save_clear_settings(bool save);

/**
 * @brief Set the AWS service callback
 * 
 * @param func Callback function
 */
void aws_svc_set_event_callback(aws_svc_event_function_t func);


#endif
```

## include/ble_cellular_service.h
```c
/**
 * @file ble_cellular_service.h
 * @brief
 *
 * Copyright (c) 2020 Laird Connectivity
 *
 * SPDX-License-Identifier: Apache-2.0
 */
#ifndef __BLE_CELLULAR_SERVICE_H__
#define __BLE_CELLULAR_SERVICE_H__

/******************************************************************************/
/* Includes                                                                   */
/******************************************************************************/
#include <drivers/modem/hl7800.h>
#include <bluetooth/conn.h>
#include <zephyr/types.h>

#ifdef __cplusplus
extern "C" {
#endif

/******************************************************************************/
/* Global Function Prototypes                                                 */
/******************************************************************************/
/**
 * @param function that sensor service should use to get connection handle when
 * determining if a value should by notified.
 */
void cell_svc_assign_connection_handler_getter(
	struct bt_conn *(*function)(void));

void cell_svc_init();
void cell_svc_set_imei(const char *imei);
void cell_svc_set_network_state(u8_t state);
void cell_svc_set_startup_state(u8_t state);
void cell_svc_set_sleep_state(u8_t state);
void cell_svc_set_apn(struct mdm_hl7800_apn *access_point);
void cell_svc_set_rssi(int value);
void cell_svc_set_sinr(int value);
void cell_svc_set_fw_ver(const char *ver);
void cell_svc_set_rat(u8_t value);
void cell_svc_set_iccid(const char *value);

#ifdef __cplusplus
}
#endif

#endif /* __BLE_CELLULAR_SERVICE_H__ */
```

## include/ble_sensor_service.h
```c
/*
 * Copyright (c) 2020 Laird Connectivity
 *
 * SPDX-License-Identifier: Apache-2.0
 */

#ifndef __BLE_SENSOR_SERVICE_H__
#define __BLE_SENSOR_SERVICE_H__

#include <bluetooth/conn.h>

/* This comes from the oob_ble.  It is used to size the BLE characteristic. */
#define MAX_SENSOR_STATE_SIZE (sizeof("CONNECTED_AND_CONFIGURED"))
#define MAX_SENSOR_STATE_STRLEN (MAX_SENSOR_STATE_SIZE - 1)

/** @param function that sensor service should use to get connection handle when
 * determining if a value should by notified.
 */
void bss_assign_connection_handler_getter(struct bt_conn *(*function)(void));

void bss_set_sensor_state(const char *state);

/** @param addr If NULL then sensor bt addr string is cleared.
 */
void bss_set_sensor_bt_addr(char *addr);

/** Initialize the sensor service
 */
void bss_init();

#endif
```

## include/bt_scan.h
```c
/**
 * @file bt_scan.h
 * @brief Controls Bluetooth scanning for multiple centrals/observers with a
 * counting semaphore.
 *
 * @note Scanning must be disabled in order to connect.
 *
 * Copyright (c) 2020 Laird Connectivity
 *
 * SPDX-License-Identifier: Apache-2.0
 */
#ifndef __BT_SCAN_H__
#define __BT_SCAN_H__

/******************************************************************************/
/* Includes                                                                   */
/******************************************************************************/
#include <zephyr/types.h>
#include <stddef.h>
#include <bluetooth/bluetooth.h>

#ifdef __cplusplus
extern "C" {
#endif

/******************************************************************************/
/* Global Function Prototypes                                                 */
/******************************************************************************/
/**
 * @brief Register user of scan module.
 *
 * @param pId user id
 * @param cb Register advertisement handler callback
 */
bool bt_scan_register(int *pId, bt_le_scan_cb_t *cb);

/**
 * @brief Start scanning (if there aren't any stop requests).
 */
void bt_scan_start(int id);

/**
 * @brief Stop scanning.
 */
void bt_scan_stop(int id);

/**
 * @brief Clear stop request.
 * Restart scanning if there aren't any stop requests and there is at least
 * one start request.
 */
void bt_scan_resume(int id);

/**
 * @brief Clear stop request, set start request, and start scanning
 * if there aren't any other stop requests.
 */
void bt_scan_restart(int id);

#ifdef __cplusplus
}
#endif

#endif /* __BT_SCAN_H__ */
```

## include/laird_bluetooth.h
```c
/**
 * @file laird_bluetooth.h
 * @brief Bluetooth helper functions
 *
 * Copyright (c) 2020 Laird Connectivity
 *
 * SPDX-License-Identifier: Apache-2.0
 */
#ifndef __LAIRD_BLUETOOTH_H__
#define __LAIRD_BLUETOOTH_H__

/******************************************************************************/
/* Includes                                                                   */
/******************************************************************************/
#include <bluetooth/gatt.h>
#include <bluetooth/bluetooth.h>
#include <zephyr/types.h>

#ifdef __cplusplus
extern "C" {
#endif

/******************************************************************************/
/* Global Constants, Macros and Type Definitions                              */
/******************************************************************************/
#define IS_NOTIFIABLE(v) ((v) == BT_GATT_CCC_NOTIFY) ? true : false;

/** The upper 8 bits of a 16 bit value */
#define MSB_16(a) (((a)&0xFF00) >> 8)
/** The lower 8 bits (of a 16 bit value) */
#define LSB_16(a) ((a)&0x00FF)

/* Client Characteristic Configuration Descriptor */
struct lbt_ccc_element {
	struct bt_gatt_ccc_cfg cfg[BT_GATT_CCC_MAX];
	bool notify;
};

/* Link a CCC handler
 * assumes lbt_ccc_element array named ccc
 * and a function of the form name_ccc_handler
 */
#define LBT_GATT_CCC(name) BT_GATT_CCC(ccc.name.cfg, name##_ccc_handler)

#define BT_SUCCESS 0

/** ATT_MTU - OpCode (1 byte) - Handle (2 bytes) */
#define BT_MAX_PAYLOAD(x) ((x)-3)

/** NRF52 reset reasons */
enum { RESET_REASON_POWER_UP = 0,
       RESET_REASON_RESETPIN,
       RESET_REASON_DOG,
       RESET_REASON_SREQ,
       RESET_REASON_LOCKUP,
       RESET_REASON_OFF,
       RESET_REASON_LPCOMP,
       RESET_REASON_DIF,
       RESET_REASON_NFC,
       RESET_REASON_VBUS,
       RESET_REASON_UNKNOWN,

       NUMBER_OF_REASON_REASONS };

/******************************************************************************/
/* Global Function Prototypes                                                 */
/******************************************************************************/
/**
 *  @brief Helper function for reading a byte from the Bluetooth stack.
 */
ssize_t lbt_read_u8(struct bt_conn *conn, const struct bt_gatt_attr *attr,
		    void *buf, u16_t len, u16_t offset);

/**
 *  @brief Helper function for reading a uint16 from the Bluetooth stack.
 */
ssize_t lbt_read_u16(struct bt_conn *conn, const struct bt_gatt_attr *attr,
		     void *buf, u16_t len, u16_t offset);

/**
 *  @brief Helper function for reading a uint32 from the Bluetooth stack.
 */
ssize_t lbt_read_u32(struct bt_conn *conn, const struct bt_gatt_attr *attr,
		     void *buf, u16_t len, u16_t offset);

/**
 *  @brief Helper function for reading an integer from the Bluetooth stack.
 */
ssize_t lbt_read_integer(struct bt_conn *conn, const struct bt_gatt_attr *attr,
			 void *buf, u16_t len, u16_t offset);

/**
 *  @brief Helper function for reading a string characteristic from
 * the Bluetooth stack.
 */
ssize_t lbt_read_string(struct bt_conn *conn, const struct bt_gatt_attr *attr,
			void *buf, u16_t len, u16_t offset,
			u16_t max_str_length);

/**
 *  @brief Helper function for reading a string characteristic from
 * the Bluetooth stack (size of full attribute will be used).
 */
ssize_t lbt_read_string_no_max_size(struct bt_conn *conn,
				    const struct bt_gatt_attr *attr, void *buf,
				    u16_t len, u16_t offset);

/**
 * @brief Helper function for writing a string characteristic from the
 * Bluetooth stack.
 * @param max_str_length is the maximum string length of the item.
 * It is assumed by this function the the actual size of the item is 1 character
 * longer so that the string can be NULL terminated.
 */
ssize_t lbt_write_string(struct bt_conn *conn, const struct bt_gatt_attr *attr,
			 const void *buf, u16_t len, u16_t offset, u8_t flags,
			 u16_t max_str_length);

/**
 * @brief Helper function for writing a u8_t from the Bluetooth stack.
 */
ssize_t lbt_write_u8(struct bt_conn *conn, const struct bt_gatt_attr *attr,
		     const void *buf, u16_t len, u16_t offset, u8_t flags);

/**
 * @brief Helper function for finding a characteristic handle in the GATT
 * table.
 */
u16_t lbt_find_gatt_index(struct bt_uuid *uuid, struct bt_gatt_attr *gatt,
			  size_t size);

/**
 * @retval ATT error code as a string.
 */
const char *lbt_get_att_err_string(u8_t code);

/**
 * @retval HCI error code as a string.
 */
const char *lbt_get_hci_err_string(u8_t code);

/**
 * @retval Reset reason code as a string.
 */
const char *lbt_get_nrf52_reset_reason_string(u8_t code);

#ifdef __cplusplus
}
#endif

#endif /* __LAIRD_BLUETOOTH_H__ */
```

## include/led.h
```c
/**
 * @file led.h
 * @brief On/Off and simple blink patterns for LED.
 *
 * Copyright (c) 2020 Laird Connectivity
 *
 * SPDX-License-Identifier: Apache-2.0
 */
#ifndef __LED_H__
#define __LED_H__

#ifdef __cplusplus
extern "C" {
#endif

/******************************************************************************/
/* Global Constants, Macros and Type Definitions                              */
/******************************************************************************/
enum led_index {
	BLUE_LED1 = 0,
	GREEN_LED2,
	RED_LED3,
	GREEN_LED4, /* not recommended for use - reserved for bootloader */

	NUMBER_OF_LEDS
};

/* The on and off times are in system ticks.
 * If the repeat count is 2 the pattern will be displayed 3
 * times (repeated twice).
 */
struct led_blink_pattern {
	s32_t on_time;
	s32_t off_time;
	u32_t repeat_count;
};

#define REPEAT_INDEFINITELY (0xFFFFFFFF)

/******************************************************************************/
/* Board definitions                                                          */
/******************************************************************************/

#define LED_OFF 0
#define LED_ON 1

#define LED1_DEV DT_GPIO_LEDS_LED_1_GPIO_CONTROLLER
#define LED1 DT_GPIO_LEDS_LED_1_GPIO_PIN
#define LED2_DEV DT_GPIO_LEDS_LED_2_GPIO_CONTROLLER
#define LED2 DT_GPIO_LEDS_LED_2_GPIO_PIN
#define LED3_DEV DT_GPIO_LEDS_LED_3_GPIO_CONTROLLER
#define LED3 DT_GPIO_LEDS_LED_3_GPIO_PIN
#define LED4_DEV DT_GPIO_LEDS_LED_4_GPIO_CONTROLLER
#define LED4 DT_GPIO_LEDS_LED_4_GPIO_PIN

/******************************************************************************/
/* Global Function Prototypes                                                 */
/******************************************************************************/

/**
 * @brief Init the LEDs for the board.
 *
 * LEDs should be off after completion.
 * Creates mutex used by on/off/blink functions.
 *
 */
void led_init(void);

/**
 * @param index is a Valid LED
 */
void led_turn_on(enum led_index index);

/**
 * @param index is a Valid LED
 */
void led_turn_off(enum led_index index);

/**
 * @param index is a Valid LED
 * @param led_blink_pattern @ref struct led_blink_pattern
 *
 * @note The pattern is copied by the LED driver.
 */
void led_blink(enum led_index index, struct led_blink_pattern const *pPattern);

/**
 * @param param function called in system work queue context
 * when pattern is complete (use NULL to disable).
 */
void led_register_pattern_complete_function(enum led_index index,
					    void (*function)(void));

/**
 * @param retval true if a blink pattern is running, false if it is complete
 */
bool led_pattern_busy(enum led_index index);

#ifdef __cplusplus
}
#endif

#endif /* __LED_H__ */
```

## include/led_configuration.h
```c
/**
 * @file led_configuration.h
 * @brief
 *
 * Copyright (c) 2020 Laird Connectivity
 *
 * SPDX-License-Identifier: Apache-2.0
 */
#ifndef __LED_CONFIGURATION_H__
#define __LED_CONFIGURATION_H__

/******************************************************************************/
/* Includes                                                                   */
/******************************************************************************/
#include "laird_led.h"

#ifdef __cplusplus
extern "C" {
#endif

/******************************************************************************/
/* Board definitions                                                          */
/******************************************************************************/

#define LED1_NODE DT_ALIAS(led0)
#define LED2_NODE DT_ALIAS(led1)
#define LED3_NODE DT_ALIAS(led2)
#define LED4_NODE DT_ALIAS(led3)

#define LED1_DEV DT_GPIO_LABEL(LED1_NODE, gpios)
#define LED1 DT_GPIO_PIN(LED1_NODE, gpios)
#define LED2_DEV DT_GPIO_LABEL(LED2_NODE, gpios)
#define LED2 DT_GPIO_PIN(LED2_NODE, gpios)
#define LED3_DEV DT_GPIO_LABEL(LED3_NODE, gpios)
#define LED3 DT_GPIO_PIN(LED3_NODE, gpios)
#define LED4_DEV DT_GPIO_LABEL(LED4_NODE, gpios)
#define LED4 DT_GPIO_PIN(LED4_NODE, gpios)

enum led_index {
	BLUE_LED1 = 0,
	GREEN_LED2,
	RED_LED3,
	GREEN_LED4, /* not recommended for use - reserved for bootloader */
};
BUILD_ASSERT(CONFIG_NUMBER_OF_LEDS > GREEN_LED4, "LED object too small");

#ifdef __cplusplus
}
#endif

#endif /* __LED_CONFIGURATION_H__ */
```

## include/nv.h
```c
/**
 * @file nv.h
 * @brief Non-volatile storage
 *
 * Copyright (c) 2020 Laird Connectivity
 *
 * SPDX-License-Identifier: Apache-2.0
 */
#ifndef __NV_H__
#define __NV_H__

#ifdef __cplusplus
extern "C" {
#endif

/******************************************************************************/
/* Global Constants, Macros and Type Definitions                              */
/******************************************************************************/
#define NV_FLASH_DEVICE DT_CHOSEN_ZEPHYR_FLASH_CONTROLLER_LABEL

#define NUM_FLASH_SECTORS 4

/******************************************************************************/
/* Global Function Prototypes                                                 */
/******************************************************************************/
int nvInit(void);
int nvReadCommissioned(bool *commissioned);
int nvStoreCommissioned(bool commissioned);
int nvStoreDevCert(uint8_t *cert, uint16_t size);
int nvStoreDevKey(uint8_t *key, uint16_t size);
int nvReadDevCert(uint8_t *cert, uint16_t size);
int nvReadDevKey(uint8_t *key, uint16_t size);
int nvDeleteDevCert(void);
int nvDeleteDevKey(void);
int nvStoreAwsEndpoint(uint8_t *ep, uint16_t size);
int nvReadAwsEndpoint(uint8_t *ep, uint16_t size);
int nvDeleteAwsEndpoint(void);
int nvStoreAwsClientId(uint8_t *id, uint16_t size);
int nvReadAwsClientId(uint8_t *id, uint16_t size);
int nvDeleteAwsClientId(void);
int nvStoreAwsRootCa(uint8_t *cert, uint16_t size);
int nvReadAwsRootCa(uint8_t *cert, uint16_t size);
int nvDeleteAwsRootCa(void);
int nvInitLwm2mConfig(void *data, void *init_value, uint16_t size);
int nvWriteLwm2mConfig(void *data, uint16_t size);
#ifdef CONFIG_APP_AWS_CUSTOMIZATION
int nvStoreAwsEnableCustom(bool Value);
int nvReadAwsEnableCustom(bool *Value);
#endif

#ifdef __cplusplus
}
#endif

#endif /* __NV_H__ */
```

## include/oob_ble.h
```c
/**
 * @file oob_ble.h
 * @brief Out-of-Box Demo BLE API
 *
 * Copyright (c) 2020 Laird Connectivity
 *
 * SPDX-License-Identifier: Apache-2.0
 */
#ifndef __OOB_BLE_H__
#define __OOB_BLE_H__

/******************************************************************************/
/* Includes                                                                   */
/******************************************************************************/
#include <bluetooth/bluetooth.h>
#include <bluetooth/hci.h>
#include <bluetooth/conn.h>
#include <bluetooth/uuid.h>
#include <bluetooth/gatt.h>
#include <misc/byteorder.h>
#include "FrameworkIncludes.h"

#ifdef __cplusplus
extern "C" {
#endif

/******************************************************************************/
/* Global Constants, Macros and Type Definitions                              */
/******************************************************************************/
/* Callback function for passing sensor data */
typedef void (*sensor_updated_function_t)(u8_t sensor, s32_t reading);

/******************************************************************************/
/* Global Function Prototypes                                                 */
/******************************************************************************/
/* Function for initialising the BLE portion of the OOB demo */
void oob_ble_initialise(const char *imei);

/* Function for setting the sensor read callback function */
void oob_ble_set_callback(sensor_updated_function_t func);

struct bt_conn *oob_ble_get_central_connection(void);

#ifdef __cplusplus
}
#endif

#endif /* __OOB_BLE_H__ */
```
