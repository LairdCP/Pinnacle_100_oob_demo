## boards/arm/pinnacle_100_dvk/Kconfig
```kconfig
# Kconfig - Pinnacle(TM) 100 DVK board configuration
#
# Copyright (c) 2019 Laird Connectivity
#
# SPDX-License-Identifier: Apache-2.0

if BOARD_PINNACLE_100_DVK

config BOARD_ENABLE_DCDC
        bool "Enable DCDC mode"
        select SOC_DCDC_NRF52X
        default y

endif # BOARD_PINNACLE_100_DVK
```

## boards/arm/pinnacle_100_dvk/Kconfig.defconfig
```kconfig
# Kconfig - Pinnacle(TM) 100 DVK board configuration
#
# Copyright (c) 2019 Laird Connectivity
#
# SPDX-License-Identifier: Apache-2.0

if BOARD_PINNACLE_100_DVK

config BOARD
	default "pinnacle_100_dvk"

if ADC

config ADC_0
	default y

endif # ADC

if I2C

config I2C_0
	default y

endif # I2C

if SPI

config SPI_0
	default y

endif # SPI

if USB

config USB_NRF52840
	def_bool y

config USB_DEVICE_STACK
	def_bool y

endif # USB

if IEEE802154

config IEEE802154_NRF5
	default y

endif # IEEE802154

config BT_CTLR
	default BT

if FLASH && SPI

config SPI_NOR
	default y

if SPI_NOR

config SPI_NOR_CS_WAIT_DELAY
	default 10

config SPI_NOR_PAGE_SIZE
	default 256

config SPI_NOR_SECTOR_SIZE
	default 4096

endif # SPI_NOR

endif # FLASH && SPI

endif # BOARD_PINNACLE_100_DVK
```

## boards/arm/pinnacle_100_dvk/pinnacle_100_dvk_defconfig
```kconfig
# Copyright (c) 2019 Laird Connectivity
#
# SPDX-License-Identifier: Apache-2.0

CONFIG_ARM=y
CONFIG_SOC_FAMILY_NRF=y
CONFIG_SOC_SERIES_NRF52X=y
CONFIG_SOC_NRF52840_QIAA=y
CONFIG_BOARD_PINNACLE_100_DVK=y

# Enable MPU
CONFIG_ARM_MPU=y

# Enable RTT
CONFIG_HAS_SEGGER_RTT=y

# enable GPIO
CONFIG_GPIO=y

# enable uart driver
CONFIG_SERIAL=y
CONFIG_UART_0_NRF_UART=y
CONFIG_UART_1_NRF_UARTE=y
CONFIG_UART_1_NRF_FLOW_CONTROL=y

# enable console
CONFIG_CONSOLE=y
CONFIG_UART_CONSOLE=y

# additional board options
CONFIG_GPIO_AS_PINRESET=y

# Flash
CONFIG_FLASH=y

# Spi
CONFIG_SPI=y

# Modem driver
CONFIG_MODEM=y
CONFIG_MODEM_RECEIVER=y
CONFIG_MODEM_HL7800=y

# Networking
CONFIG_NETWORKING=y
CONFIG_NET_IPV4=y
CONFIG_NET_TCP=y
# disable IPv6 for now
CONFIG_NET_IPV6=n
CONFIG_NET_CONFIG_NEED_IPV6=n
```

## west.yml
```yaml
# The west manifest file for Pinnacle 100.
#
# The per-installation west configuration file, .west/config, sets the
# path to the project containing this file in the [manifest] section's
# "path" variable.
#
# You are free to create your own manifest files and put them in any
# repository you want, to create your own custom Zephyr installations.
# For example, you could create a manifest file in your own out of
# tree application directory, which would pull this zephyr repository
# in as an ordinary project.
#
# You can pass your manifest repositories to west init when creating a
# new Zephyr installation. See the west documentation for more
# information.

manifest:

  remotes:
    - name: LairdCP
      url-base: https://github.com/LairdCP
    - name: zephyrproject
      url-base: https://github.com/zephyrproject-rtos

  # Please add items below based on alphabetical order
  # Many of these dependencies we taken from the default Zephyr west manifest.
  # These dependencies may need updating if new features are added to the firmware.
  projects:
    - name: mbedtls
      revision: ca32746072ce3381f1c9ae46ba6cd34c69f8c0ee
      path: modules/crypto/mbedtls
      remote: zephyrproject
    - name: zephyr
      repo-path: zephyr
      west-commands: scripts/west-commands.yml
      revision: 162cf0dbe93c7be1f778f1876b6987a125ab3811
      remote: LairdCP

  self:
    path: pinnacle100
```
